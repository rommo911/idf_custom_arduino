## Kconfig.projbuild
```kconfig
menu "Arduino Configuration"

config ENABLE_ARDUINO_DEPENDS
    bool
    select LWIP_SO_RCVBUF
    select ETHERNET
    select WIFI_ENABLED
    select ESP32_PHY_CALIBRATION_AND_DATA_STORAGE if IDF_TARGET_ESP32
    select MEMMAP_SMP
    default "y"

choice ARDUINO_RUNNING_CORE
    bool "Core on which Arduino's setup() and loop() are running"
    default ARDUINO_RUN_CORE1
    help
        Select on which core Arduino's setup() and loop() functions run

    config ARDUINO_RUN_CORE0
        bool "CORE 0"
    config ARDUINO_RUN_CORE1
        bool "CORE 1"
    config ARDUINO_RUN_NO_AFFINITY
        bool "BOTH"
endchoice

config ARDUINO_RUNNING_CORE
    int
    default 0 if ARDUINO_RUN_CORE0
    default 1 if ARDUINO_RUN_CORE1
    default -1 if ARDUINO_RUN_NO_AFFINITY

config ARDUINO_LOOP_STACK_SIZE
    int "Loop thread stack size"
    default 8192
    help
        Amount of stack available for the Arduino task.

choice ARDUINO_EVENT_RUNNING_CORE
    bool "Core on which Arduino's event handler is running"
    default ARDUINO_EVENT_RUN_CORE1
    help
        Select on which core Arduino's WiFi.onEvent() run

    config ARDUINO_EVENT_RUN_CORE0
        bool "CORE 0"
    config ARDUINO_EVENT_RUN_CORE1
        bool "CORE 1"
    config ARDUINO_EVENT_RUN_NO_AFFINITY
        bool "BOTH"

endchoice

config ARDUINO_EVENT_RUNNING_CORE
    int
    default 0 if ARDUINO_EVENT_RUN_CORE0
    default 1 if ARDUINO_EVENT_RUN_CORE1
    default -1 if ARDUINO_EVENT_RUN_NO_AFFINITY


config ARDUINO_UDP_TASK_PRIORITY
    int "Priority of the UDP task"
    default 3
    help
        Select at what priority you want the UDP task to run.

config ARDUINO_UDP_RUNNING_CORE
    int
    default 0 if ARDUINO_UDP_RUN_CORE0
    default 1 if ARDUINO_UDP_RUN_CORE1
    default -1 if ARDUINO_UDP_RUN_NO_AFFINITY

choice ARDUINO_UDP_RUNNING_CORE
    bool "Core on which Arduino's UDP is running"
    default ARDUINO_UDP_RUN_CORE1
    help
        Select on which core Arduino's UDP run
    config ARDUINO_UDP_RUN_CORE0
        bool "CORE 0"
    config ARDUINO_UDP_RUN_CORE1
        bool "CORE 1"
    config ARDUINO_UDP_RUN_NO_AFFINITY
        bool "BOTH"

endchoice

config ARDUINO_UDP_RUNNING_CORE
    int
    default 0 if ARDUINO_UDP_RUN_CORE0
    default 1 if ARDUINO_UDP_RUN_CORE1
    default -1 if ARDUINO_UDP_RUN_NO_AFFINITY
endmenu
```
